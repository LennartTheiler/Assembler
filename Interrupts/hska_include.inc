;*********************************************************
;                         Programmbeschreibung  
; - Autor, Date: Reiner Kriesten, 2010-04-01:
; - Creation: 
;   -- copy SFRs out of DAVE, save in separate Header
;   -- include Header in separate C-File and generate SRC-file 
;   -- include further your own definitions 
; 
; - Attention: 
;   -- use "Keep Variables in Order" flag 
;      (option for C-File (right mouse click), Tab C51)
;   -- in order to get Port Names create IO.h out of DAVE. 
;      This is done by activating clicking IO_vInit
;
; - Use of this file: 
;   -- one-time action: copy File into standard KEIL Folder
;      (e.g. \KEIL\C51\A51) 
;	-- assembler program file: insert statement
;      "$include(hska_include.inc)"
;*********************************************************


$NOMOD51 ;NOMOD51 directive suppresses pre-definition
         ; of 8051 SFR names.

NAME	HSKA_INCLUDE_
; ******************************************************
; ******* SFR-Definitionen HSKA: Reiner Kriesten *******
; ** SFRs that have addresses in the form of 1XXXX000B 
; ** (e.g., 80H, 88H, 90H, ..., F0H, F8H) are bitaddressable.
; ******************************************************
P0_0	BIT	080H
P0_1	BIT	081H
P0_2	BIT	082H
P0_3	BIT	083H
P0_4	BIT	084H
P0_5	BIT	085H
P0_6	BIT	086H
P0_7	BIT	087H

P1_0	BIT	090H
P1_1	BIT	091H
P1_2	BIT	092H
P1_3	BIT	093H
P1_4	BIT	094H
P1_5	BIT	095H
P1_6	BIT	096H
P1_7	BIT	097H

P2_0	BIT	0A0H
P2_1	BIT	0A1H
P2_2	BIT	0A2H
P2_3	BIT	0A3H
P2_4	BIT	0A4H
P2_5	BIT	0A5H
P2_6	BIT	0A6H
P2_7	BIT	0A7H

P3_0	BIT	0B0H
P3_1	BIT	0B1H
P3_2	BIT	0B2H
P3_3	BIT	0B3H
P3_4	BIT	0B4H
P3_5	BIT	0B5H
P3_6	BIT	0B6H
P3_7	BIT	0B7H

P4_0	BIT	0C8H
P4_1	BIT	0C9H
P4_2	BIT	0CAH
P4_3	BIT	0CBH
P4_4	BIT	0CCH
P4_5	BIT	0CDH
P4_6	BIT	0CEH
P4_7	BIT	0CFH

; Port 5 is not bit adressable 

; ******************************************************
; ******* SFR-Defintionen from DAVE (thanks);-)) *******
; ******************************************************
ACC	DATA	0E0H
ADC_CHCTR0	DATA	0CAH
ADC_CHCTR1	DATA	0CBH
ADC_CHCTR2	DATA	0CCH
ADC_CHCTR3	DATA	0CDH
ADC_CHCTR4	DATA	0CEH
ADC_CHCTR5	DATA	0CFH
ADC_CHCTR6	DATA	0D2H
ADC_CHCTR7	DATA	0D3H
ADC_CHINCR	DATA	0CBH
ADC_CHINFR	DATA	0CAH
ADC_CHINPR	DATA	0CDH
ADC_CHINSR	DATA	0CCH
ADC_CRCR1	DATA	0CAH
ADC_CRMR1	DATA	0CCH
ADC_CRPR1	DATA	0CBH
ADC_ETRCR	DATA	0CFH
ADC_EVINCR	DATA	0CFH
ADC_EVINFR	DATA	0CEH
ADC_EVINPR	DATA	0D3H
ADC_EVINSR	DATA	0D2H
ADC_GLOBCTR	DATA	0CAH
ADC_GLOBSTR	DATA	0CBH
ADC_INPCR0	DATA	0CEH
ADC_LCBR	DATA	0CDH
ADC_PAGE	DATA	0D1H
ADC_PRAR	DATA	0CCH
ADC_Q0R0	DATA	0CFH
ADC_QBUR0	DATA	0D2H
ADC_QINR0	DATA	0D2H
ADC_QMR0	DATA	0CDH
ADC_QSR0	DATA	0CEH
ADC_RCR0	DATA	0CAH
ADC_RCR1	DATA	0CBH
ADC_RCR2	DATA	0CCH
ADC_RCR3	DATA	0CDH
ADC_RESR0H	DATA	0CBH
ADC_RESR0L	DATA	0CAH
ADC_RESR1H	DATA	0CDH
ADC_RESR1L	DATA	0CCH
ADC_RESR2H	DATA	0CFH
ADC_RESR2L	DATA	0CEH
ADC_RESR3H	DATA	0D3H
ADC_RESR3L	DATA	0D2H
ADC_RESRA0H	DATA	0CBH
ADC_RESRA0L	DATA	0CAH
ADC_RESRA1H	DATA	0CDH
ADC_RESRA1L	DATA	0CCH
ADC_RESRA2H	DATA	0CFH
ADC_RESRA2L	DATA	0CEH
ADC_RESRA3H	DATA	0D3H
ADC_RESRA3L	DATA	0D2H
ADC_VFCR	DATA	0CEH
B	DATA	0F0H
BCON	DATA	0BDH
BG	DATA	0BEH
CAN_ADCON	DATA	0D8H
CAN_ADH	DATA	0DAH
CAN_ADL	DATA	0D9H
CAN_DATA0	DATA	0DBH
CAN_DATA1	DATA	0DCH
CAN_DATA2	DATA	0DDH
CAN_DATA3	DATA	0DEH
CCU6_CC60RH	DATA	0FBH
CCU6_CC60RL	DATA	0FAH
CCU6_CC60SRH	DATA	0FBH
CCU6_CC60SRL	DATA	0FAH
CCU6_CC61RH	DATA	0FDH
CCU6_CC61RL	DATA	0FCH
CCU6_CC61SRH	DATA	0FDH
CCU6_CC61SRL	DATA	0FCH
CCU6_CC62RH	DATA	0FFH
CCU6_CC62RL	DATA	0FEH
CCU6_CC62SRH	DATA	0FFH
CCU6_CC62SRL	DATA	0FEH
CCU6_CC63RH	DATA	09BH
CCU6_CC63RL	DATA	09AH
CCU6_CC63SRH	DATA	09BH
CCU6_CC63SRL	DATA	09AH
CCU6_CMPMODIFH	DATA	0A7H
CCU6_CMPMODIFL	DATA	0A6H
CCU6_CMPSTATH	DATA	0FFH
CCU6_CMPSTATL	DATA	0FEH
CCU6_IENH	DATA	09DH
CCU6_IENL	DATA	09CH
CCU6_INPH	DATA	09FH
CCU6_INPL	DATA	09EH
CCU6_ISH	DATA	09DH
CCU6_ISL	DATA	09CH
CCU6_ISRH	DATA	0A5H
CCU6_ISRL	DATA	0A4H
CCU6_ISSH	DATA	0A5H
CCU6_ISSL	DATA	0A4H
CCU6_MCMCTR	DATA	0A7H
CCU6_MCMOUTH	DATA	09BH
CCU6_MCMOUTL	DATA	09AH
CCU6_MCMOUTSH	DATA	09FH
CCU6_MCMOUTSL	DATA	09EH
CCU6_MODCTRH	DATA	0FDH
CCU6_MODCTRL	DATA	0FCH
CCU6_PAGE	DATA	0A3H
CCU6_PISEL0H	DATA	09FH
CCU6_PISEL0L	DATA	09EH
CCU6_PISEL2	DATA	0A4H
CCU6_PSLR	DATA	0A6H
CCU6_T12DTCH	DATA	0A5H
CCU6_T12DTCL	DATA	0A4H
CCU6_T12H	DATA	0FBH
CCU6_T12L	DATA	0FAH
CCU6_T12MSELH	DATA	09BH
CCU6_T12MSELL	DATA	09AH
CCU6_T12PRH	DATA	09DH
CCU6_T12PRL	DATA	09CH
CCU6_T13H	DATA	0FDH
CCU6_T13L	DATA	0FCH
CCU6_T13PRH	DATA	09FH
CCU6_T13PRL	DATA	09EH
CCU6_TCTR0H	DATA	0A7H
CCU6_TCTR0L	DATA	0A6H
CCU6_TCTR2H	DATA	0FBH
CCU6_TCTR2L	DATA	0FAH
CCU6_TCTR4H	DATA	09DH
CCU6_TCTR4L	DATA	09CH
CCU6_TRPCTRH	DATA	0FFH
CCU6_TRPCTRL	DATA	0FEH
CD_CON	DATA	0A1H
CD_CORDXH	DATA	09BH
CD_CORDXL	DATA	09AH
CD_CORDYH	DATA	09DH
CD_CORDYL	DATA	09CH
CD_CORDZH	DATA	09FH
CD_CORDZL	DATA	09EH
CD_STATC	DATA	0A0H
CMCON	DATA	0BAH
COCON	DATA	0BEH
DPH	DATA	083H
DPL	DATA	082H
EO	DATA	0A2H
EXICON0	DATA	0B7H
EXICON1	DATA	0BAH
FDCON	DATA	0E9H
FDRES	DATA	0EBH
FDSTEP	DATA	0EAH
FEAH	DATA	0BDH
FEAL	DATA	0BCH
HWBPDR	DATA	0F7H
HWBPSR	DATA	0F6H
ID	DATA	0B3H
IEN0	DATA	0A8H
IEN1	DATA	0E8H
IP	DATA	0B8H
IP1	DATA	0F8H
IPH	DATA	0B9H
IPH1	DATA	0F9H
IRCON0	DATA	0B4H
IRCON1	DATA	0B5H
IRCON2	DATA	0B6H
IRCON3	DATA	0B4H
IRCON4	DATA	0B5H
MDU_MD0	DATA	0B2H
MDU_MD1	DATA	0B3H
MDU_MD2	DATA	0B4H
MDU_MD3	DATA	0B5H
MDU_MD4	DATA	0B6H
MDU_MD5	DATA	0B7H
MDU_MDUCON	DATA	0B1H
MDU_MDUSTAT	DATA	0B0H
MDU_MR0	DATA	0B2H
MDU_MR1	DATA	0B3H
MDU_MR2	DATA	0B4H
MDU_MR3	DATA	0B5H
MDU_MR4	DATA	0B6H
MDU_MR5	DATA	0B7H
MISC_CON	DATA	0E9H
MMBPCR	DATA	0F3H
MMCR	DATA	0F1H
MMCR2	DATA	0E9H
MMDR	DATA	0F5H
MMICR	DATA	0F4H
MMSR	DATA	0F2H
MMWR1	DATA	0EBH
MMWR2	DATA	0ECH
MODPISEL	DATA	0B3H
MODPISEL1	DATA	0B7H
MODPISEL2	DATA	0BAH
MODSUSP	DATA	0BDH
NMICON	DATA	0BBH
NMISR	DATA	0BCH
OSC_CON	DATA	0B6H
P0_ALTSEL0	DATA	080H
P0_ALTSEL1	DATA	086H
P0_DATA	DATA	080H
P0_DIR	DATA	086H
P0_OD	DATA	080H
P0_PUDEN	DATA	086H
P0_PUDSEL	DATA	080H
P1_ALTSEL0	DATA	090H
P1_ALTSEL1	DATA	091H
P1_DATA	DATA	090H
P1_DIR	DATA	091H
P1_OD	DATA	090H
P1_PUDEN	DATA	091H
P1_PUDSEL	DATA	090H
P2_DATA	DATA	0A0H
P2_DIR	DATA	0A1H
P2_PUDEN	DATA	0A1H
P2_PUDSEL	DATA	0A0H
P3_ALTSEL0	DATA	0B0H
P3_ALTSEL1	DATA	0B1H
P3_DATA	DATA	0B0H
P3_DIR	DATA	0B1H
P3_OD	DATA	0B0H
P3_PUDEN	DATA	0B1H
P3_PUDSEL	DATA	0B0H
P4_ALTSEL0	DATA	0C8H
P4_ALTSEL1	DATA	0C9H
P4_DATA	DATA	0C8H
P4_DIR	DATA	0C9H
P4_OD	DATA	0C8H
P4_PUDEN	DATA	0C9H
P4_PUDSEL	DATA	0C8H
P5_ALTSEL0	DATA	092H
P5_ALTSEL1	DATA	093H
P5_DATA	DATA	092H
P5_DIR	DATA	093H
P5_OD	DATA	092H
P5_PUDEN	DATA	093H
P5_PUDSEL	DATA	092H
PASSWD	DATA	0BBH
PCON	DATA	087H
PLL_CON	DATA	0B7H
PMCON0	DATA	0B4H
PMCON1	DATA	0B5H
PMCON2	DATA	0BBH
PORT_PAGE	DATA	0B2H
PSW	DATA	0D0H
SBUF	DATA	099H
SCON	DATA	098H
SCU_PAGE	DATA	0BFH
SP	DATA	081H
SSC_BRH	DATA	0AFH
SSC_BRL	DATA	0AEH
SSC_CONH_O	DATA	0ABH
SSC_CONH_P	DATA	0ABH
SSC_CONL_O	DATA	0AAH
SSC_CONL_P	DATA	0AAH
SSC_PISEL	DATA	0A9H
SSC_RBL	DATA	0ADH
SSC_TBL	DATA	0ACH
SYSCON0	DATA	08FH
T21_RC2H	DATA	0C3H
T21_RC2L	DATA	0C2H
T21_T2CON	DATA	0C0H
T21_T2H	DATA	0C5H
T21_T2L	DATA	0C4H
T21_T2MOD	DATA	0C1H
T2_RC2H	DATA	0C3H
T2_RC2L	DATA	0C2H
T2_T2CON	DATA	0C0H
T2_T2H	DATA	0C5H
T2_T2L	DATA	0C4H
T2_T2MOD	DATA	0C1H
TCON	DATA	088H
TH0	DATA	08CH
TH1	DATA	08DH
TL0	DATA	08AH
TL1	DATA	08BH
TMOD	DATA	089H
UART1_BCON	DATA	0CAH
UART1_BG	DATA	0CBH
UART1_FDCON	DATA	0CCH
UART1_FDRES	DATA	0CEH
UART1_FDSTEP	DATA	0CDH
UART1_SBUF	DATA	0C9H
UART1_SCON	DATA	0C8H
WDTCON	DATA	0BBH
WDTH	DATA	0BFH
WDTL	DATA	0BEH
WDTREL	DATA	0BCH
WDTWINB	DATA	0BDH
XADDRH	DATA	0B3H
CD_BSY	BIT	0A0H.0
DMAP	BIT	0A0H.4
EOC	BIT	0A0H.2
ERROR	BIT	0A0H.1
INT_EN	BIT	0A0H.3
KEEPX	BIT	0A0H.5
KEEPY	BIT	0A0H.6
KEEPZ	BIT	0A0H.7
EA	BIT	0A8H.7
ES	BIT	0A8H.4
ET0	BIT	0A8H.1
ET1	BIT	0A8H.3
ET2	BIT	0A8H.5
EX0	BIT	0A8H.0
EX1	BIT	0A8H.2
EADC	BIT	0E8H.0
ECCIP0	BIT	0E8H.4
ECCIP1	BIT	0E8H.5
ECCIP2	BIT	0E8H.6
ECCIP3	BIT	0E8H.7
ESSC	BIT	0E8H.1
EX2	BIT	0E8H.2
EXM	BIT	0E8H.3
PADC	BIT	0F8H.0
PCCIP0	BIT	0F8H.4
PCCIP1	BIT	0F8H.5
PCCIP2	BIT	0F8H.6
PCCIP3	BIT	0F8H.7
PSSC	BIT	0F8H.1
PX2	BIT	0F8H.2
PXM	BIT	0F8H.3
PS	BIT	0B8H.4
PT0	BIT	0B8H.1
PT1	BIT	0B8H.3
PT2	BIT	0B8H.5
PX0	BIT	0B8H.0
PX1	BIT	0B8H.2
IERR	BIT	0B0H.1
IRDY	BIT	0B0H.0
MDU_BSY	BIT	0B0H.2
AC	BIT	0D0H.6
CY	BIT	0D0H.7
F0	BIT	0D0H.5
F1	BIT	0D0H.1
OV	BIT	0D0H.2
P	BIT	0D0H.0
RS0	BIT	0D0H.3
RS1	BIT	0D0H.4
RB8	BIT	098H.2
REN	BIT	098H.4
RI	BIT	098H.0
SM0	BIT	098H.7
SM1	BIT	098H.6
SM2	BIT	098H.5
TB8	BIT	098H.3
TI	BIT	098H.1
C_T2	BIT	0C0H.1
CP_RL2	BIT	0C0H.0
EXEN2	BIT	0C0H.3
EXF2	BIT	0C0H.6
TF2	BIT	0C0H.7
TR2	BIT	0C0H.2
IE0	BIT	088H.1
IE1	BIT	088H.3
IT0	BIT	088H.0
IT1	BIT	088H.2
TF0	BIT	088H.5
TF1	BIT	088H.7
TR0	BIT	088H.4
TR1	BIT	088H.6
RB8_1	BIT	0C8H.2
REN_1	BIT	0C8H.4
RI_1	BIT	0C8H.0
SM0_1	BIT	0C8H.7
SM1_1	BIT	0C8H.6
SM2_1	BIT	0C8H.5
TB8_1	BIT	0C8H.3
TI_1	BIT	0C8H.1
ADC_RESR0LH	DATA	0CAH
ADC_RESR1LH	DATA	0CCH
ADC_RESR2LH	DATA	0CEH
ADC_RESR3LH	DATA	0D2H
ADC_RESRA0LH	DATA	0CAH
ADC_RESRA1LH	DATA	0CCH
ADC_RESRA2LH	DATA	0CEH
ADC_RESRA3LH	DATA	0D2H
CAN_ADLH	DATA	0D9H
CAN_DATA01	DATA	0DBH
CAN_DATA23	DATA	0DDH
CCU6_CC60RLH	DATA	0FAH
CCU6_CC60SRLH	DATA	0FAH
CCU6_CC61RLH	DATA	0FCH
CCU6_CC61SRLH	DATA	0FCH
CCU6_CC62RLH	DATA	0FEH
CCU6_CC62SRLH	DATA	0FEH
CCU6_CC63RLH	DATA	09AH
CCU6_CC63SRLH	DATA	09AH
CCU6_T12LH	DATA	0FAH
CCU6_T12PRLH	DATA	09CH
CCU6_T13LH	DATA	0FCH
CCU6_T13PRLH	DATA	09EH
T21_RC2LH	DATA	0C2H
T21_T2LH	DATA	0C4H
T2_RC2LH	DATA	0C2H
T2_T2LH	DATA	0C4H
